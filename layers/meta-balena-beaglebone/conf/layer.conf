## layers/meta-balena-beaglebone/conf/layer.conf
```bitbake
BBPATH .= ":${LAYERDIR}"

BBFILES += "${LAYERDIR}/recipes-*/*/*.bb \
            ${LAYERDIR}/recipes-*/*/*.bbappend"

BBFILE_COLLECTIONS += "balena-beaglebone"
BBFILE_PATTERN_balena-beaglebone := "^${LAYERDIR}/"
BBFILE_PRIORITY_balena-beaglebone = "1337"

LAYERDEPENDS_balena-beaglebone = "core"
LAYERDEPENDS_balena-beaglebone += "openembedded-layer"
LAYERDEPENDS_balena-beaglebone += "networking-layer"
LAYERDEPENDS_balena-beaglebone += "balena-common"
LAYERDEPENDS_balena-beaglebone += "balena-kirkstone"
LAYERDEPENDS_balena-beaglebone += "meta-ti-bsp"

PREFERRED_PROVIDER_virtual/kernel:beaglebone = "linux-beagleboard"
PREFERRED_PROVIDER_virtual/bootloader:beaglebone = "u-boot"
PREFERRED_PROVIDER_u-boot:beaglebone = "u-boot"

PREFERRED_PROVIDER_virtual/kernel:beagleboard-xm = "linux-beagleboard"
PREFERRED_PROVIDER_virtual/bootloader:beagleboard-xm = "u-boot"
PREFERRED_PROVIDER_u-boot:beagleboard-xm = "u-boot"

MACHINE_FEATURES:remove:beaglebone-ai64 = "efi"

PREFERRED_PROVIDER_virtual/bootloader:beaglebone-ai64 = "u-boot-bb.org"
PREFERRED_PROVIDER_u-boot:beaglebone-ai64 = "u-boot-bb.org"
PREFERRED_PROVIDER_virtual/bootloader:beaglebone-ai64-k3r5 = "u-boot-bb.org"
PREFERRED_PROVIDER_u-boot:beaglebone-ai64-k3r5 = "u-boot-bb.org"
UBOOT_MACHINE:beaglebone-ai64 = "j721e_evm_a72_defconfig"
UBOOT_CONFIG_FRAGMENTS:beaglebone-ai64 = ""
UBOOT_MACHINE:beaglebone-ai64-k3r5 = "j721e_evm_r5_defconfig"
UBOOT_CONFIG_FRAGMENTS:beaglebone-ai64-k3r5 = ""
# meta-ti-bsp's k3.inc uses fitImage, which we do not use.
KERNEL_IMAGETYPES:beaglebone-ai64 = "Image"
KERNEL_CLASSES:beaglebone-ai64 = "kernel-uimage"

MACHINE_FEATURES:remove:beagleplay = "efi"

PREFERRED_PROVIDER_virtual/bootloader:beagleplay = "u-boot-bb.org"
PREFERRED_PROVIDER_virtual/bootloader:beagleplay-k3r5 = "u-boot-bb.org"
PREFERRED_PROVIDER_u-boot:beagleplay = "u-boot-bb.org"
PREFERRED_PROVIDER_u-boot:beagleplay-k3r5 = "u-boot-bb.org"
PREFERRED_VERSION_u-boot-tools:beagleplay ?= "2022.01"
PREFERRED_VERSION_u-boot-tools:beagleplay-k3r5 ?= "2022.01"
PREFERRED_VERSION_u-boot-tools-native:beagleplay ?= "2022.01"
PREFERRED_VERSION_u-boot-tools-native:beagleplay-k3r5 ?= "2022.01"

LAYERSERIES_COMPAT_balena-beaglebone = " kirkstone "
MACHINE_ESSENTIAL_EXTRA_RDEPENDS:remove = "kernel-image-zimage"
MACHINE_ESSENTIAL_EXTRA_RDEPENDS:remove = "kernel-image-image"
MACHINE_ESSENTIAL_EXTRA_RDEPENDS:remove = "kernel-modules-headers"

TI_COMMON_DEPLOY = "${DEPLOY_DIR}"
TI_TMPDIR_APPEND = ""
```

## layers/meta-balena-beaglebone/conf/machine/beagleboard-xm.conf
```bitbake
#@TYPE: Machine
#@NAME: BeagleBoard-XM
#@DESCRIPTION: Machine configuration for the BeagleBoard-XM

MACHINEOVERRIDES = "beagleboard:${MACHINE}"

include conf/machine/beagleboard.conf
```

## layers/meta-balena-beaglebone/conf/machine/beaglebone-green-gateway.conf
```bitbake
#@TYPE: Machine
#@NAME: BeagleBone Green Gateway
#@DESCRIPTION: Machine configuration for the BeagleBone Green Gateway

MACHINEOVERRIDES = "beaglebone:${MACHINE}"

include conf/machine/beaglebone.conf
```

## layers/meta-balena-beaglebone/conf/machine/beaglebone-green-wifi.conf
```bitbake
#@TYPE: Machine
#@NAME: BeagleBone Green Wireless
#@DESCRIPTION: Machine configuration for the BeagleBone Green Wireless

MACHINEOVERRIDES = "beaglebone:${MACHINE}"

include conf/machine/beaglebone.conf
```

## layers/meta-balena-beaglebone/conf/machine/beaglebone-play-k3r5.conf
```bitbake
#@TYPE: Machine
#@NAME: BeaglePlay
#@DESCRIPTION: Machine configuration for BeaglePlay

MACHINEOVERRIDES = "beagleplay-k3r5:${MACHINE}"

include conf/machine/beagleplay-k3r5.conf

PREFERRED_VERSION_u-boot-tools ?= "2022.01"
```

## layers/meta-balena-beaglebone/conf/machine/beaglebone-play.conf
```bitbake
#@TYPE: Machine
#@NAME: BeaglePlay
#@DESCRIPTION: Machine configuration for BeaglePlay

MACHINEOVERRIDES = "beagleplay:${MACHINE}"

include conf/machine/beagleplay.conf

PREFERRED_VERSION_u-boot-tools ?= "2022.01"
```

## layers/meta-balena-beaglebone/conf/machine/beaglebone-pocket.conf
```bitbake
#@TYPE: Machine
#@NAME: PocketBeagle
#@DESCRIPTION: Machine configuration for the PocketBeagle

MACHINEOVERRIDES = "beaglebone:${MACHINE}"

include conf/machine/beaglebone.conf

KERNEL_DEVICETREE:beaglebone-pocket = "am335x-pocketbeagle.dtb "
```

## layers/meta-resin-beaglebone/conf/machine/beaglebone-green.conf
```bitbake
#@TYPE: Machine
#@NAME: BeagleBone Green
#@DESCRIPTION: Machine configuration for the BeagleBone Green

MACHINEOVERRIDES = "beaglebone:${MACHINE}"

include conf/machine/beaglebone.conf
```

## layers/meta-resin-beaglebone/conf/machine/beaglebone-pocket.conf
```bitbake
#@TYPE: Machine
#@NAME: PocketBeagle
#@DESCRIPTION: Machine configuration for the PocketBeagle

MACHINEOVERRIDES = "beaglebone:${MACHINE}"

include conf/machine/beaglebone.conf

KERNEL_DEVICETREE_beaglebone-pocket = "am335x-pocketbeagle.dtb "
SERIAL_CONSOLE_beaglebone-pocket = "115200 ttyGS0"
```
