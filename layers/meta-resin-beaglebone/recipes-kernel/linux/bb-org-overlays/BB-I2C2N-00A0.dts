/*
 * Virtual cape for disabling I2C2
 *
 * This program is free software; you can redistribute it and/or modify
 * it under the terms of the GNU General Public License version 2 as
 * published by the Free Software Foundation.
 */
/dts-v1/;
/plugin/;

/ {
	compatible = "ti,beaglebone", "ti,beaglebone-black", "ti,beaglebone-green";

	/* identification */
	part-number = "BB-I2C2N";
	version = "00A0";

	fragment@0 {
		target = <&i2c2>;
		__overlay__ {
			status = "disabled";
		};
	};
};
